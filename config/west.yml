## config/west.yml
```yaml
manifest:
  remotes:
    - name: zmkfirmware
      url-base: https://github.com/zmkfirmware
    - name: tht78
      url-base: https://github.com/tht78
  projects:
    - name: zmk
      remote: tht78
      revision: main
      import: app/west.yml
  self:
    path: config
```
